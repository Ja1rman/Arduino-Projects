                                                      // Не использовать магнитометр.
                                                                                      //
#include <iarduino_OLED.h>                                                            // Подключаем библиотеку iarduino_OLED.
iarduino_OLED myOLED(0x3C);                                                           // Объявляем объект myOLED, указывая адрес дисплея на шине I2C: 0x3C.
extern uint8_t MediumFontRus[];                                                       // Подключаем шрифт MediumFontRus.
                                                                                      //
                    /* Объявляем массивы и переменные: */                             //
const int startLevel = 6;                                                             // Константа определяющая с какого уровня загрузить игру.
const int quantityLevel = 6;                                                          // Константа определяющая количество уровней массива.
const uint32_t tableArray[quantityLevel][68] PROGMEM = {                              // Двумерный массив для локаций, содержащий в себе 5 уровней. Каждый массив содержит в себе 64 элемента по 32 бита. Каждый бит соответствует квадрату на экране размером 2 на два пикселя.
{                                                                                     //
  0b00000000000000000000000000000000, // 1                                            //
  0b00000000000000000000000000000000, // 2                                            //
  0b00000000000000000000000000000000, // 3                                            //
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  55,                                                                                 // Y - координата положения лунки.
},                                                                                    //
                                                                                      //
{                                                                                     //
  0b00000000000000000000000000000000, // 1                                            //
  0b00000000000000000000000000000000, // 2                                            //
  0b00000000000000000000000000000000, // 3                                            //
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  24,                                                                                 // Y - координата положения лунки.
},                                                                                    //
                                                                                      //
{                                                                                     //
  0b00000000000000000000000000000000, // 1                                            //
  0b00000000000000000000000000000000, // 2                                            //
  0b00000000000000000000000000000000, // 3                                            //
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  40,                                                                                 // Y - координата положения лунки.
},                                                                                    //
                                                                                      //
{                                                                                     //
  0b00000000100000000000010000000000, // 1                                            //
  0b00000000100000000000001000000000, // 2                                            //
  0b00000000100000000000000100000000, // 3                                            //
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  23,                                                                                 // Y - координата положения лунки.
},                                                                                    //
                                                                                      //
{                                                                                     //
  0b00000000000000000000001000000000, // 1                                            //
  0b00000000000000000000000100000000, // 2                                            //
  0b00000000000000000000000010000000, // 3                                            //
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  25,                                                                                 // Y - координата положения лунки.
},                                                                                    //
//************************************************************************************//
{
  0b11111111111111111111111100000000, // 1                                            //
  0b11111111111111111111100000000000,// 2                                            //
  0b11111111111111111000000000000000, // 3                                            //
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  38,    
}
//************************************************************************************//
};                                                                                    //
                                                                                      //
int y, x;                                                                             // Переменные положения движения.
int yh, xh;                                                                           // Переменные положения лунки.
int ys, xs;                                                                           // Вспомогательные переменные для запоминания последних координат.
int limited;                                                                          // Переменная регулирования скорости.
int Level;                                                                            // Переменная выбора уровня.
                                                                                      //
                                  /* Объявляем функции: */                            //
                                                                                      //
void Draw();                                                                          // Функция прорисовки шарик.
void Logic();                                                                         // Функция движения шарика.
void GameOver();                                                                      // Функция завершения игры.
void CheckBlock();                                                                    // Функция проверки столкновения шарика с препятствиями.
void Location();                                                                      // Функция прорисовки локации.
void LevelWin();                                                                      // Функция прохождения уровня.
void GameWin();                                                                       // Функция прохождения игры.
void Position();                                                                      // Функция для задания начального положения шарика и лунки.
void ShowLevel();                                                                     // Функция вывода заставки уровня.
void StartScreen();                                                                   // Функция вывода заставки игры.
                                                                                      //
void setup()                                                                          //
{                                                                                     //
  myOLED.begin();                                                                     // Инициируем работу с дисплеем.
  myOLED.autoUpdate(false);                                                           // Запрещаем автоматический вывод данных. Информация на дисплее будет обновляться только после обращения к функции update().
                                                                                      //
  while(!Serial){}                                                                    // Ждём готовность Serial к передаче данных в монитор последовательного порта.
  //sensor.begin(true);                                                                 // Инициируем работу с датчиками объекта sensor.
                                                                                      // 
  StartScreen();                                                                      // Выводим заставку игры.
  Level = startLevel - 1;                                                             // Присваиваем переменной выбора уровня первый уровень. Цифра ноль соответствует первому элементу двумерного массива.
  ShowLevel();                                                                        // Показываем заставку уровня.
  Position();                                                                         // Определяем начальные координаты шарика и координаты лунки.
  Location();                                                                         // Прорисовываем локацию.
}                                                                                     //
                                                                                      //
void loop()                                                                           //
{                                                                                     //
  xs = x; ys = y;                                                                     // Каждый цикл присваиваем вспомогательным переменным предыдущие координаты шарика.
  Logic();                                                                            // Двигаем шарик в зависимости от направления. От угла наклона акселерометра.
  Draw();                                                                             // Рисуем шарик на новых координатах.
  CheckBlock();                                                                       // Проверяем не столкнулся ли шарик с преградой.
  LevelWin();                                                                         // Проверяем выигрышную позицию.
  myOLED.update();                                                                    // Разрешаем автоматический вывод данных.
}                                                                                     //
                                                                                      //
void StartScreen(){                                                                   // Функция вывода заставки игры.
  myOLED.drawRect (0, 0, 127, 63, false, 1);                                          // Прорисовываем рамку игрового поля.
  myOLED.setFont(MediumFontRus);                                                      // Указываем шрифт который требуется использовать для вывода цифр и текста.
  myOLED.print("ЛАБИРИНТ", OLED_C, 60);                                               // Выводим текст по центру 50 строки.
                                                                                      //
  for (int i = 35; i >= 3; i = i - 8) {                                               // Цикл формирования картинки.          //
  myOLED.drawRect   (30, i,  36, i + 6, true , 1);}                                   // Выводим картинку на экран.           //
  for (int i = 30; i <= 94; i = i + 8){                                               // Цикл формирования картинки.          //        # # # # # # # # #
  myOLED.drawRect   (i, 3,  i + 6, 9, true , 1);}                                     // Выводим картинку на экран.           //        #               #
  for (int i = 3; i <= 35; i = i + 8) {                                               // Цикл формирования картинки.          //        #   # # # # #   #
  myOLED.drawRect   (94, i,  100, i + 6, true , 1);}                                  // Выводим картинку на экран.           //        #               #
  for (int i = 94; i >= 30; i = i - 8){                                               // Цикл формирования картинки.          //        # # # # # # # # #
  myOLED.drawRect   (i, 35,  i + 6, 41, true , 1);}                                   // Выводим картинку на экран.           //
  for (int i = 46; i <= 78; i = i + 8){                                               // Цикл формирования картинки.          //
  myOLED.drawRect   (i, 19,  i + 6, 25, true , 1);}                                   // Выводим картинку на экран.           //
                                                                                      // 
  x = 89; y = 29; xh = 41; yh = 29;                                                   // Координаты начального положения шарика и лунки для анимации заставки
                                                                                      //
  for (int i = 1; i <= 48; i++){                                                      // Цикл формирования анимацию.
  xs = x; ys = y;                                                                     // Каждый цикл присваиваем вспомогательным переменным предыдущие координаты шарика.
  x--;                                                                                // Двигаем шарик влево.
  myOLED.drawCircle (xs, ys, 2,  true, 0);                                            // Очищаем последнее положения шарика.
  myOLED.drawCircle ( x,  y, 2,  true, 1);                                            // Рисуем шарик в указанных координатах радиусом 2.
  myOLED.drawCircle (xh, yh, 3, false, 1);                                            // Рисуем лунку в указанных координатах радиусом 3.
  myOLED.update();}                                                                   // Разрешаем автоматический вывод данных.
  delay(2000);                                                                        // Задержка 2 секунды.
                                                                                      //  
  myOLED.clrScr();                                                                    // Чистим экран.
  myOLED.drawRect (0, 0, 127, 63, false, 1);                                          // Прорисовываем рамку игрового поля.
  myOLED.print("От", OLED_C, 25);                                                     // Выводим текст по центру 20 строки.
  myOLED.print("NanGame", OLED_C, 50);                                                // Выводим текст по центру 20 строки.
  myOLED.update();                                                                    // Разрешаем автоматический вывод данных.
  delay (2000);                                                                       // Задержка 2 секунды.
}                                                                                     //
                                                                                      //
void ShowLevel(){                                                                     // Функция показа заставки уровня.
  myOLED.clrScr();                                                                    // Очищаем дисплей.
  myOLED.drawRect (0, 0, 127, 63, false, 1);                                          // Прорисовываем рамку игрового поля.
  myOLED.setFont(MediumFontRus);                                                      // Указываем шрифт который требуется использовать для вывода цифр и текста.
  myOLED.print("Уровень", 12, OLED_C);                                                // Выводим текст по центру 5 столбца.
  myOLED.print(Level+1, 101, OLED_C);                                                 // Выводим текст по центру 100 столбца.
  myOLED.update();                                                                    // Разрешаем автоматический вывод данных.
  delay(3000);                                                                        // Задержка 3 секунды.
}                                                                                     //
                                                                                      //
void GameWin(){                                                                       // Функция прохождения игры.
  if (Level == quantityLevel){                                                        // Сравниваем переменную выбора уровня с числом 5. Если она равна пяти, то игра пройдена.
    myOLED.clrScr();                                                                  // Очищаем дисплей.
    myOLED.setFont(MediumFontRus);                                                    // Указываем шрифт который требуется использовать для вывода цифр и текста.
    myOLED.print("ВЫИГРЫШ!", 20, OLED_C);                                             // Выводим текст по центру 20 столбца.
    myOLED.update();                                                                  // Разрешаем автоматический вывод данных.
    delay(3000);                                                                      // Задержка 3 секунды.
    return setup();                                                                   // Возвращаемся в начало игры.
  }                                                                                   //
}                                                                                     //
void LevelWin(){                                                                      // функция прохождения игры.
  if ( y == yh && x == xh || y == yh + 1 && x == xh || y == yh - 1 && x == xh || y == yh && x == xh + 1 || y == yh && x == xh - 1){ // Если координаты лунки совпадают с координатами шарика, то уровень пройден.
    Level++;                                                                          // Увеличиваем переменную выбора уровней на один. Будет отрисовываться следующий уровень.
    GameWin();                                                                        // Проверяем, мы прошли все уровни.
    ShowLevel();                                                                      // Показываем заставку следующего уровня.
    Position();                                                                       // Определяем начальные координаты шарика и координаты лунки следующего уровня.
    Location();                                                                       // Отрисовываем уровень.
    return loop();                                                                    // Возвращаемся в цикл игры.
  }                                                                                   //
}                                                                                     //
                                                                                      //
void Location(){                                                                      // Функция прорисовки уровня.
    for (int j = 0; j < 64; j++){                                                     // Прорисовываем массив с помощью циклов. Цикл по j соответствует X-координате.
    for (int i = 0; i < 32; i++){                                                     // Цикл по i соответствует Y-координате.
    myOLED.drawRect (j*2, i*2, j*2+2, i*2+2, true, bitRead(pgm_read_dword(&tableArray[Level][j]),i));}} // Заполняем поле квадратиками размером 2 на 2 пикселя в соответствии с выбранным массивом. Если бит элемента массива равен 1, то на экране отрисуется квадрат.
    myOLED.drawRect (0, 0, 127, 63, false, 1);                                        // Прорисовываем рамку игрового поля.
}                                                                                     //
                                                                                      //
void CheckBlock(){                                                                    // Функция проверки столкновения шарика с препятствием.
  if (x > 124 || x < 3 || y > 60 || y < 3){GameOver();}                               // Проверка выхода шарика за пределы игрового поля. Если координаты движения больше, чем игровое поле, то игра заканчивается.
  bool f = 0;                                                                         // Вспомогательная переменная для проверки совершения события.
  for(int i=x-2; i<=x+2; i++){                                                        // Проходим по колонкам шарика.
  for(int j=y-2; j<=y+2; j++){                                                        // Проходим по строкам шарика. Соответствуют координаты шарика с координатами препятствий.
  if(bitRead(pgm_read_dword(&tableArray[Level][i/2]),j/2)){f =1;}}}                   // Проверка на соответствие координат шарика с координатами препятствий. Если соответствуют, то присваиваем переменной события значение true.
  if(f){GameOver();}                                                                  // Если переменная события равна 1, то игра заканчивается.
}                                                                                     //
                                                                                      //
void Draw(){                                                                          // Функция отрисовки шарика и лунки.
  myOLED.drawCircle (xs, ys, 2,  true, 0);                                            // Очищаем последнее положения шарика.
  myOLED.drawCircle ( x,  y, 2,  true, 1);                                            // Рисуем шарик в указанных координатах радиусом 2.
  myOLED.drawCircle (xh, yh, 3, false, 1);                                            // Рисуем лунку в указанных координатах радиусом 3.
}                                                                                     //
                                                                                      //
void Logic(){                                                                         // Функция движения шарика.
int vrx=analogRead(A0);
int vry=analogRead(A1);
if(vrx>700)x++;
 if(vrx<300)x--;
 if(vry>700)y++;
if(vry<300)y--;
if(x>128)x=128;
if(x<0)x=0;
if(y>128)y=128;
if(y<0)y=0;                                                                                 // Читаем данные датчика (акселерометра).
                                                                                      // Движение влево.
  // Это реализовано с помощью цикла, который ограничивает прорисовку шарика. Шарик при большой скорости рисуется не в каждой следующей координате, а через определенное количество шагов в зависимости от скорости.
}                                                                                     //
                                                                                      //
void GameOver(){                                                                      // Функция завершения игры.
  myOLED.drawPixel (x+6, y, 1);                                                       // Прорисовываем картинку проигрышного положения.
  myOLED.drawPixel (x+5, y, 1);                                                       //
  myOLED.drawPixel (x+4, y, 1);                                                       //
  myOLED.drawPixel (x-6, y, 1);                                                       //
  myOLED.drawPixel (x-5, y, 1);                                                       //                              #
  myOLED.drawPixel (x-4, y, 1);                                                       //                         #    #    #
  myOLED.drawPixel (x, y+6, 1);                                                       //                          #   #   #  
  myOLED.drawPixel (x, y+5, 1);                                                       //                           #     #   
  myOLED.drawPixel (x, y+4, 1);                                                       //                             ###     
  myOLED.drawPixel (x, y-6, 1);                                                       //                            #####    
  myOLED.drawPixel (x, y-5, 1);                                                       //                        ### ##### ###
  myOLED.drawPixel (x, y-4, 1);                                                       //                            #####    
  myOLED.drawPixel (x+5, y+5, 1);                                                     //                             ###     
  myOLED.drawPixel (x+4, y+4, 1);                                                     //                           #     #   
  myOLED.drawPixel (x+3, y+3, 1);                                                     //                          #   #   #  
  myOLED.drawPixel (x-5, y-5, 1);                                                     //                         #    #    #
  myOLED.drawPixel (x-4, y-4, 1);                                                     //                              #
  myOLED.drawPixel (x-3, y-3, 1);                                                     //
  myOLED.drawPixel (x-5, y+5, 1);                                                     //
  myOLED.drawPixel (x-4, y+4, 1);                                                     //
  myOLED.drawPixel (x-3, y+3, 1);                                                     //
  myOLED.drawPixel (x+5, y-5, 1);                                                     //
  myOLED.drawPixel (x+4, y-4, 1);                                                     //
  myOLED.drawPixel (x+3, y-3, 1);                                                     //
  myOLED.update();                                                                    // Разрешаем автоматический вывод данных.
  delay(500);                                                                         // Задержка 500 мс.
  myOLED.clrScr();                                                                    // Очищаем экран.
  Position();                                                                         // Определяем начальные координаты шарика и координаты лунки следующего уровня.
  Location();                                                                         // Отрисовываем уровень.
  return loop();                                                                      // Возвращаемся в цикл игры.
}                                                                                     //
                                                                                      //
void Position()                                                                       // Функция для задания начального положения шарика и лунки.
{                                                                                     //
    x = pgm_read_dword(&tableArray[Level][64]);                                       // Координаты начального положения шарика в зависимости от уровня.
    y = pgm_read_dword(&tableArray[Level][65]);                                       //
                                                                                      //
    xh = pgm_read_dword(&tableArray[Level][66]);                                      // Координаты начального положения шарика и лунки второго уровня.
    yh = pgm_read_dword(&tableArray[Level][67]);                                      //
}                                                                                     //
